## config/boards/shields/81hg_kbd/dts/bindings/input/pwm-joystick.yaml
```yaml
# Copyright (c) 2025 The ZMK Contributors
# SPDX-License-Identifier: MIT

description: |
  PWM duty-cycle based joystick input driver.
  Reads 1 kHz PWM signals from a GP9101F1K converter and translates
  duty-cycle deviations into relative mouse movements.

compatible: "pwm-joystick"

properties:
  x-gpios:
    type: phandle-array
    required: true
    description: GPIO connected to X-axis PWM output

  y-gpios:
    type: phandle-array
    required: true
    description: GPIO connected to Y-axis PWM output

  poll-period-ms:
    type: int
    default: 10
    description: Milliseconds between each movement report

  deadzone-pct:
    type: int
    default: 5
    description: Dead zone as percentage of full duty-cycle range

  slow-gain:
    type: int
    default: 26
    description: |
      Linear gain of the slow (precision) zone, in 1/100 subpixel per
      duty-cycle unit per poll. Higher = faster slow-zone cursor.

  knee:
    type: int
    default: 1200
    description: |
      Deflection (duty-cycle units past the deadzone) where the fast
      quadratic zone starts. Lower = acceleration kicks in earlier.

  fast-gain-div:
    type: int
    default: 280
    description: |
      Divisor of the quadratic fast-zone term. Lower = stronger
      acceleration / higher top speed.

  invert-x:
    type: boolean
    description: Invert X-axis direction

  invert-y:
    type: boolean
    description: Invert Y-axis direction

  swap-xy:
    type: boolean
    description: Swap X and Y axes
```
